/*
 * pn532-spi-overlay.dts
 *
 * Device Tree overlay to register the PN532 on SPI0, chip-select 0.
 * Compile with:
 *   dtc -@ -I dts -O dtb -o pn532-spi.dtbo pn532-spi-overlay.dts
 * Install on Raspberry Pi:
 *   sudo cp pn532-spi.dtbo /boot/overlays/
 *   # add to /boot/config.txt:  dtoverlay=pn532-spi
 */

/dts-v1/;
/plugin/;

/ {
    compatible = "brcm,bcm2835";

    fragment@0 {
        target = <&spi0>;
        __overlay__ {
            status = "okay";

            pn532: pn532@0 {
                compatible        = "nxp,pn532";
                reg               = <0>;           /* chip select 0 = CE0 = GPIO8 */
                spi-max-frequency = <5000000>;      /* 5 MHz */
            };
        };
    };
};
